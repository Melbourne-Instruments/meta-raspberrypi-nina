## conf/layer.conf
```bitbake
# We have a conf and classes directory, add to BBPATH
BBPATH .= ":${LAYERDIR}"

# We have recipes-* directories, add to BBFILES
BBFILES += "${LAYERDIR}/recipes-*/*/*.bb \
    ${LAYERDIR}/recipes-*/*/*.bbappend"

BBFILE_COLLECTIONS += "meta-raspberrypi-nina"
BBFILE_PATTERN_meta-raspberrypi-nina = "^${LAYERDIR}/"
BBFILE_PRIORITY_meta-raspberrypi-nina = "9"
LAYERSERIES_COMPAT_meta-raspberrypi-nina = "hardknott dunfell"
```
